/*
 * CAUTION: This file is automatically generated by Xilinx.
 * Version: HSI 2017.4
 * Today is: Thu Aug  9 20:58:05 2018
 */


/dts-v1/;
/include/ "zynq-7000.dtsi"
/include/ "snickerdoodle-prime.dtsi"
/include/ "pl.dtsi"
/include/ "pcw.dtsi"
/ {
	chosen {
		bootargs = "earlycon";
		stdout-path = "serial0:115200n8";
	};
	aliases {
		serial0 = &uart0;
		spi0 = &qspi;
		spi1 = &spi0;
		spi2 = &spi1;
	};
	memory {
		device_type = "memory";
		reg = <0x0 0x20000000>;
	};
};
